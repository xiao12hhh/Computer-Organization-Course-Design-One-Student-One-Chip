## pa2/course_io_defconfig
```kconfig
CONFIG_ISA_riscv=y
# CONFIG_RV64 is not set
CONFIG_TARGET_NATIVE_ELF=y
# CONFIG_TRACE is not set
# CONFIG_CC_DEBUG is not set
CONFIG_CC_O2=y
CONFIG_DEVICE=y
CONFIG_HAS_SERIAL=y
CONFIG_HAS_TIMER=y
CONFIG_HAS_KEYBOARD=y
CONFIG_HAS_VGA=y
CONFIG_VGA_SIZE_400x300=y
CONFIG_VGA_SHOW_SCREEN=y
# CONFIG_HAS_AUDIO is not set
# CONFIG_HAS_DISK is not set
# CONFIG_HAS_SDCARD is not set
```

## pa2/course_pa2_defconfig
```kconfig
CONFIG_ISA_riscv=y
# CONFIG_RV64 is not set
CONFIG_TARGET_NATIVE_ELF=y
# CONFIG_TRACE is not set
CONFIG_CC_DEBUG=y
CONFIG_DEVICE=y
CONFIG_HAS_SERIAL=y
# CONFIG_HAS_TIMER is not set
# CONFIG_HAS_KEYBOARD is not set
# CONFIG_HAS_VGA is not set
# CONFIG_HAS_AUDIO is not set
# CONFIG_HAS_DISK is not set
# CONFIG_HAS_SDCARD is not set
```
